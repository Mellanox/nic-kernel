## drivers/vfio/pci/Kconfig
```kconfig
# SPDX-License-Identifier: GPL-2.0-only
menu "VFIO support for PCI devices"
	depends on PCI

config VFIO_PCI_CORE
	tristate
	select VFIO_VIRQFD
	select IRQ_BYPASS_MANAGER

config VFIO_PCI_INTX
	def_bool y if !S390
	depends on VFIO_PCI_CORE

config VFIO_PCI
	tristate "Generic VFIO support for any PCI device"
	select VFIO_PCI_CORE
	help
	  Support for the generic PCI VFIO bus driver which can connect any
	  PCI device to the VFIO framework.

	  If you don't know what to do here, say N.

if VFIO_PCI
config VFIO_PCI_VGA
	bool "Generic VFIO PCI support for VGA devices"
	depends on X86 && VGA_ARB
	help
	  Support for VGA extension to VFIO PCI.  This exposes an additional
	  region on VGA devices for accessing legacy VGA addresses used by
	  BIOS and generic video drivers.

	  If you don't know what to do here, say N.

config VFIO_PCI_IGD
	bool "Generic VFIO PCI extensions for Intel graphics (GVT-d)"
	depends on X86
	default y
	help
	  Support for Intel IGD specific extensions to enable direct
	  assignment to virtual machines.  This includes exposing an IGD
	  specific firmware table and read-only copies of the host bridge
	  and LPC bridge config space.

	  To enable Intel IGD assignment through vfio-pci, say Y.
endif

config VFIO_PCI_ZDEV_KVM
	bool "VFIO PCI extensions for s390x KVM passthrough"
	depends on S390 && KVM
	default y
	help
	  Support s390x-specific extensions to enable support for enhancements
	  to KVM passthrough capabilities, such as interpretive execution of
	  zPCI instructions.

	  To enable s390x KVM vfio-pci extensions, say Y.

config VFIO_PCI_DMABUF
	bool "VFIO PCI extensions for DMA-BUF"
	depends on VFIO_PCI_CORE
	depends on PCI_P2PDMA && DMA_SHARED_BUFFER
	default y
	help
	  Enable support for VFIO PCI extensions that allow exporting
	  device MMIO regions as DMA-BUFs for peer devices to access via
	  peer-to-peer (P2P) DMA.

	  This feature enables a VFIO-managed PCI device to export a portion
	  of its MMIO BAR as a DMA-BUF file descriptor, which can be passed
	  to other userspace drivers or kernel subsystems capable of
	  initiating DMA to that region.

	  Say Y here if you want to enable VFIO DMABUF-based MMIO export
	  support for peer-to-peer DMA use cases.

	  If unsure, say N.

source "drivers/vfio/pci/mlx5/Kconfig"

source "drivers/vfio/pci/hisilicon/Kconfig"

source "drivers/vfio/pci/pds/Kconfig"

source "drivers/vfio/pci/virtio/Kconfig"

source "drivers/vfio/pci/nvgrace-gpu/Kconfig"

source "drivers/vfio/pci/qat/Kconfig"

endmenu
```
